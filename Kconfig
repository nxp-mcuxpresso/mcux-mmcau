## Kconfig
```kconfig
# Copyright 2024 NXP
# SPDX-License-Identifier: BSD-3-Clause

menu "mmcau"

    config MCUX_COMPONENT_middleware.mmcau.cm4_cm7
        bool "CM4/CM7 MMCAU"
        select MCUX_COMPONENT_middleware.mmcau.common_files
        select MCUX_COMPONENT_driver.clock
        depends on MCUX_HW_CORE_CM4 || MCUX_HW_CORE_CM4F || MCUX_HW_CORE_CM7F

    config MCUX_COMPONENT_middleware.mmcau.cm0p
        bool "CM0+ MMCAU"
        select MCUX_COMPONENT_middleware.mmcau.common_files
        select MCUX_COMPONENT_driver.clock
        depends on MCUX_HW_CORE_CM0P

    config MCUX_COMPONENT_middleware.mmcau.common_files
        bool "Common Files"

    config MCUX_COMPONENT_middleware.mmcau.mmcau_files
        bool "MMCAU Files"
endmenu
```
